/*
 * SPDX-FileCopyrightText: 2025
 *
 * SPDX-License-Identifier: Apache-2.0
 */
#include <cstdio>
#include <cstring>
#include "lvgl.h"
#include "esp_brookesia.hpp"
#include "freertos/FreeRTOS.h"
#include "freertos/task.h"
#ifdef ESP_UTILS_LOG_TAG
#   undef ESP_UTILS_LOG_TAG
#endif
#define ESP_UTILS_LOG_TAG "BS:Settings"
#include "esp_lib_utils.h"
#include "esp_brookesia_app_settings.hpp"
#include "music_font.h"
#include "sys_net.h"

#define APP_NAME "Settings"

// iOS-like dark palette (pure black background: AMOLED pixels are off)
#define COLOR_BG        0x000000
#define COLOR_CARD      0x1C1C1E
#define COLOR_ROW       0x2C2C2E
#define COLOR_PRESSED   0x3A3A3C
#define COLOR_TEXT      0xFFFFFF
#define COLOR_DIM       0x8E8E93
#define COLOR_OFF       0x48484A
#define COLOR_ACCENT    0x0A84FF
#define COLOR_OK        0x30D158
#define COLOR_WARN      0xFF9F0A
#define COLOR_ERR       0xFF453A

#define REFRESH_MS      300
#define JOIN_OK_SHOW_MS 1500            // Success screen time before returning to the list

// 466x466 round screen: every widget stays inside the circle (half-width at distance d from the
// centre is sqrt(233^2 - d^2)), so lists and the keyboard are narrower than the screen
#define NET_LIST_W          340
#define NET_LIST_Y          200
#define NET_LIST_H          180
#define KB_W            380
#define KB_H            186

LV_IMG_DECLARE(esp_brookesia_app_icon_settings);

using namespace std;
using namespace esp_brookesia::gui;
using namespace esp_brookesia::systems;

namespace esp_brookesia::apps {

Settings *Settings::_instance = nullptr;

// The CJK font lives in XiaoZhi's assets partition; mapping it reads flash, which asserts on the
// LVGL task (PSRAM stack). Load it from a task with an internal-RAM stack.
static bool s_init_started;

static void init_task(void *arg)
{
    music_font_load(&lv_font_montserrat_24);
    vTaskDelete(nullptr);
}

Settings *Settings::requestInstance()
{
    if (_instance == nullptr) {
        _instance = new Settings();
    }
    return _instance;
}

// name="Settings", launcher_icon (assets/, generated by tools/make_icons.py), use_default_screen=true
Settings::Settings():
    App(APP_NAME, &esp_brookesia_app_icon_settings, true)
{
}

Settings::~Settings()
{
}

// ---------------------------------------------------------------- small widgets
static void set_text_if_changed(lv_obj_t *label, const char *text)
{
    if (strcmp(lv_label_get_text(label), text) != 0) {
        lv_label_set_text(label, text);
    }
}

static lv_obj_t *create_plain(lv_obj_t *parent)
{
    lv_obj_t *obj = lv_obj_create(parent);
    lv_obj_remove_style_all(obj);
    lv_obj_remove_flag(obj, LV_OBJ_FLAG_SCROLLABLE);
    return obj;
}

static lv_obj_t *create_label(lv_obj_t *parent, uint32_t color, const lv_font_t *font = nullptr)
{
    lv_obj_t *label = lv_label_create(parent);
    lv_obj_set_style_text_color(label, lv_color_hex(color), 0);
    if (font != nullptr) {
        lv_obj_set_style_text_font(label, font, 0);
    }
    lv_label_set_text(label, "");
    return label;
}

static int signal_level(int rssi)
{
    return (rssi >= -55) ? 4 : (rssi >= -67) ? 3 : (rssi >= -77) ? 2 : 1;
}

// Four rising bars, like a phone's WiFi strength indicator
static void create_signal_bars(lv_obj_t *parent, int rssi)
{
    lv_obj_t *box = create_plain(parent);
    lv_obj_set_size(box, 22, 18);
    lv_obj_set_flex_flow(box, LV_FLEX_FLOW_ROW);
    lv_obj_set_flex_align(box, LV_FLEX_ALIGN_START, LV_FLEX_ALIGN_END, LV_FLEX_ALIGN_END);
    lv_obj_set_style_pad_column(box, 2, 0);
    int level = signal_level(rssi);
    for (int i = 0; i < 4; i++) {
        lv_obj_t *bar = create_plain(box);
        lv_obj_set_size(bar, 4, 6 + i * 4);
        lv_obj_set_style_radius(bar, 1, 0);
        lv_obj_set_style_bg_opa(bar, LV_OPA_COVER, 0);
        lv_obj_set_style_bg_color(bar, lv_color_hex(i < level ? COLOR_TEXT : COLOR_OFF), 0);
    }
}

// Small padlock drawn from two rectangles (the built-in symbol font has no lock)
static void create_lock(lv_obj_t *parent)
{
    lv_obj_t *box = create_plain(parent);
    lv_obj_set_size(box, 12, 17);
    lv_obj_t *shackle = create_plain(box);
    lv_obj_set_size(shackle, 8, 10);
    lv_obj_set_style_radius(shackle, 4, 0);
    lv_obj_set_style_border_width(shackle, 2, 0);
    lv_obj_set_style_border_color(shackle, lv_color_hex(COLOR_DIM), 0);
    lv_obj_align(shackle, LV_ALIGN_TOP_MID, 0, 0);
    lv_obj_t *body = create_plain(box);
    lv_obj_set_size(body, 12, 9);
    lv_obj_set_style_radius(body, 2, 0);
    lv_obj_set_style_bg_opa(body, LV_OPA_COVER, 0);
    lv_obj_set_style_bg_color(body, lv_color_hex(COLOR_DIM), 0);
    lv_obj_align(body, LV_ALIGN_BOTTOM_MID, 0, 0);
}

lv_obj_t *Settings::createButton(lv_obj_t *parent, const char *text, uint32_t color, int w, lv_event_cb_t cb)
{
    lv_obj_t *btn = lv_button_create(parent);
    lv_obj_set_size(btn, w, 54);
    lv_obj_set_style_radius(btn, 27, 0);
    lv_obj_set_style_shadow_width(btn, 0, 0);
    lv_obj_set_style_bg_color(btn, lv_color_hex(color), 0);
    lv_obj_set_style_bg_color(btn, lv_color_hex(COLOR_PRESSED), LV_STATE_PRESSED);
    lv_obj_add_event_cb(btn, cb, LV_EVENT_CLICKED, nullptr);
    lv_obj_t *label = create_label(btn, COLOR_TEXT);
    lv_label_set_text(label, text);
    lv_obj_center(label);
    return btn;
}

// ---------------------------------------------------------------- pages
void Settings::buildMain(lv_obj_t *scr)
{
    _page_main = create_plain(scr);
    lv_obj_set_size(_page_main, LV_PCT(100), LV_PCT(100));

    lv_obj_t *title = create_label(_page_main, COLOR_TEXT);
    lv_label_set_text(title, "无线网络");
    lv_obj_align(title, LV_ALIGN_TOP_MID, 0, 30);

    // Status card: current connection
    lv_obj_t *card = create_plain(_page_main);
    lv_obj_set_size(card, 320, 84);
    lv_obj_align(card, LV_ALIGN_TOP_MID, 0, 74);
    lv_obj_set_style_radius(card, 22, 0);
    lv_obj_set_style_bg_opa(card, LV_OPA_COVER, 0);
    lv_obj_set_style_bg_color(card, lv_color_hex(COLOR_CARD), 0);
    lv_obj_set_style_pad_hor(card, 20, 0);

    _status_dot = create_plain(card);
    lv_obj_set_size(_status_dot, 12, 12);
    lv_obj_set_style_radius(_status_dot, LV_RADIUS_CIRCLE, 0);
    lv_obj_set_style_bg_opa(_status_dot, LV_OPA_COVER, 0);
    lv_obj_align(_status_dot, LV_ALIGN_LEFT_MID, 0, -14);

    _status_title = create_label(card, COLOR_TEXT);
    lv_obj_set_width(_status_title, 250);
    lv_label_set_long_mode(_status_title, LV_LABEL_LONG_MODE_DOTS);
    lv_obj_align(_status_title, LV_ALIGN_LEFT_MID, 24, -16);

    _status_detail = create_label(card, COLOR_DIM, &lv_font_montserrat_18);
    lv_obj_set_width(_status_detail, 270);
    lv_label_set_long_mode(_status_detail, LV_LABEL_LONG_MODE_DOTS);
    lv_obj_align(_status_detail, LV_ALIGN_LEFT_MID, 0, 22);

    // Section header + rescan
    lv_obj_t *header = create_label(_page_main, COLOR_DIM);
    lv_label_set_text(header, "附近的网络");
    lv_obj_align(header, LV_ALIGN_TOP_LEFT, (466 - NET_LIST_W) / 2 + 8, 164);

    _rescan_btn = lv_button_create(_page_main);
    lv_obj_set_size(_rescan_btn, 44, 36);
    lv_obj_set_style_radius(_rescan_btn, 18, 0);
    lv_obj_set_style_shadow_width(_rescan_btn, 0, 0);
    lv_obj_set_style_bg_color(_rescan_btn, lv_color_hex(COLOR_ROW), 0);
    lv_obj_set_style_bg_color(_rescan_btn, lv_color_hex(COLOR_PRESSED), LV_STATE_PRESSED);
    lv_obj_align(_rescan_btn, LV_ALIGN_TOP_RIGHT, -(466 - NET_LIST_W) / 2 - 4, 160);
    lv_obj_add_event_cb(_rescan_btn, onRescan, LV_EVENT_CLICKED, nullptr);
    lv_obj_t *icon = create_label(_rescan_btn, COLOR_ACCENT, &lv_font_montserrat_20);
    lv_label_set_text(icon, LV_SYMBOL_REFRESH);
    lv_obj_center(icon);

    _rescan_spinner = lv_spinner_create(_page_main);
    lv_obj_set_size(_rescan_spinner, 30, 30);
    lv_spinner_set_anim_params(_rescan_spinner, 1000, 60);
    lv_obj_set_style_arc_width(_rescan_spinner, 4, LV_PART_MAIN);
    lv_obj_set_style_arc_width(_rescan_spinner, 4, LV_PART_INDICATOR);
    lv_obj_set_style_arc_color(_rescan_spinner, lv_color_hex(COLOR_ROW), LV_PART_MAIN);
    lv_obj_set_style_arc_color(_rescan_spinner, lv_color_hex(COLOR_ACCENT), LV_PART_INDICATOR);
    lv_obj_align_to(_rescan_spinner, _rescan_btn, LV_ALIGN_CENTER, 0, 0);
    lv_obj_add_flag(_rescan_spinner, LV_OBJ_FLAG_HIDDEN);

    _list = lv_obj_create(_page_main);
    lv_obj_remove_style_all(_list);
    lv_obj_set_size(_list, NET_LIST_W, NET_LIST_H);
    lv_obj_align(_list, LV_ALIGN_TOP_MID, 0, NET_LIST_Y);
    lv_obj_set_flex_flow(_list, LV_FLEX_FLOW_COLUMN);
    lv_obj_set_style_pad_row(_list, 6, 0);
    lv_obj_set_scroll_dir(_list, LV_DIR_VER);
    lv_obj_set_scrollbar_mode(_list, LV_SCROLLBAR_MODE_OFF);

    // XiaoZhi's OTA server (host only: the URL path is a secret)
    _server = create_label(_page_main, COLOR_DIM, &lv_font_montserrat_18);
    lv_obj_set_width(_server, 280);
    lv_obj_set_style_text_align(_server, LV_TEXT_ALIGN_CENTER, 0);
    lv_label_set_long_mode(_server, LV_LABEL_LONG_MODE_DOTS);
    lv_obj_align(_server, LV_ALIGN_TOP_MID, 0, NET_LIST_Y + NET_LIST_H + 14);
}

void Settings::buildPassword(lv_obj_t *scr)
{
    _page_password = create_plain(scr);
    lv_obj_set_size(_page_password, LV_PCT(100), LV_PCT(100));
    lv_obj_set_style_bg_opa(_page_password, LV_OPA_COVER, 0);
    lv_obj_set_style_bg_color(_page_password, lv_color_hex(COLOR_BG), 0);

    _pw_title = create_label(_page_password, COLOR_TEXT);
    lv_obj_set_width(_pw_title, 290);
    lv_obj_set_style_text_align(_pw_title, LV_TEXT_ALIGN_CENTER, 0);
    lv_label_set_long_mode(_pw_title, LV_LABEL_LONG_MODE_DOTS);
    lv_obj_align(_pw_title, LV_ALIGN_TOP_MID, 0, 36);

    _pw_text = lv_textarea_create(_page_password);
    lv_obj_set_size(_pw_text, 270, 54);
    lv_obj_align(_pw_text, LV_ALIGN_TOP_MID, -26, 88);
    lv_textarea_set_one_line(_pw_text, true);
    lv_textarea_set_password_mode(_pw_text, true);
    lv_textarea_set_max_length(_pw_text, 64);
    lv_textarea_set_placeholder_text(_pw_text, "Password");
    lv_obj_set_style_text_font(_pw_text, &lv_font_montserrat_24, 0);
    lv_obj_set_style_text_color(_pw_text, lv_color_hex(COLOR_TEXT), 0);
    lv_obj_set_style_bg_color(_pw_text, lv_color_hex(COLOR_CARD), 0);
    lv_obj_set_style_border_width(_pw_text, 2, 0);
    lv_obj_set_style_border_color(_pw_text, lv_color_hex(COLOR_ACCENT), LV_STATE_FOCUSED);
    lv_obj_set_style_border_color(_pw_text, lv_color_hex(COLOR_ROW), 0);
    lv_obj_set_style_radius(_pw_text, 16, 0);
    lv_obj_add_state(_pw_text, LV_STATE_FOCUSED);

    lv_obj_t *eye = lv_button_create(_page_password);
    lv_obj_set_size(eye, 46, 46);
    lv_obj_set_style_radius(eye, LV_RADIUS_CIRCLE, 0);
    lv_obj_set_style_shadow_width(eye, 0, 0);
    lv_obj_set_style_bg_color(eye, lv_color_hex(COLOR_ROW), 0);
    lv_obj_align_to(eye, _pw_text, LV_ALIGN_OUT_RIGHT_MID, 8, 0);
    lv_obj_add_event_cb(eye, onEyeToggle, LV_EVENT_CLICKED, nullptr);
    lv_obj_t *eye_icon = create_label(eye, COLOR_TEXT, &lv_font_montserrat_20);
    lv_label_set_text(eye_icon, LV_SYMBOL_EYE_OPEN);
    lv_obj_center(eye_icon);

    lv_obj_t *kb = lv_keyboard_create(_page_password);
    lv_obj_set_size(kb, KB_W, KB_H);
    lv_obj_align(kb, LV_ALIGN_TOP_MID, 0, 152);
    lv_keyboard_set_textarea(kb, _pw_text);
    lv_obj_set_style_text_font(kb, &lv_font_montserrat_20, 0);
    lv_obj_set_style_bg_color(kb, lv_color_hex(COLOR_BG), 0);
    lv_obj_set_style_bg_color(kb, lv_color_hex(COLOR_ROW), LV_PART_ITEMS);
    lv_obj_set_style_bg_color(kb, lv_color_hex(COLOR_ACCENT), (lv_style_selector_t)LV_PART_ITEMS | (lv_style_selector_t)LV_STATE_CHECKED);
    lv_obj_set_style_text_color(kb, lv_color_hex(COLOR_TEXT), LV_PART_ITEMS);
    lv_obj_set_style_border_width(kb, 0, 0);
    lv_obj_set_style_pad_all(kb, 2, 0);
    lv_obj_set_style_pad_gap(kb, 4, 0);
    lv_obj_add_event_cb(kb, onKeyboard, LV_EVENT_READY, nullptr);
    lv_obj_add_event_cb(kb, onKeyboard, LV_EVENT_CANCEL, nullptr);

    lv_obj_t *row = create_plain(_page_password);
    lv_obj_set_size(row, 270, 54);
    lv_obj_align(row, LV_ALIGN_TOP_MID, 0, 152 + KB_H + 12);
    lv_obj_set_flex_flow(row, LV_FLEX_FLOW_ROW);
    lv_obj_set_flex_align(row, LV_FLEX_ALIGN_SPACE_BETWEEN, LV_FLEX_ALIGN_CENTER, LV_FLEX_ALIGN_CENTER);
    createButton(row, "取消", COLOR_ROW, 124, onPasswordCancel);
    createButton(row, "连接", COLOR_ACCENT, 124, onPasswordConnect);
}

void Settings::buildJoining(lv_obj_t *scr)
{
    _page_joining = create_plain(scr);
    lv_obj_set_size(_page_joining, LV_PCT(100), LV_PCT(100));
    lv_obj_set_style_bg_opa(_page_joining, LV_OPA_COVER, 0);
    lv_obj_set_style_bg_color(_page_joining, lv_color_hex(COLOR_BG), 0);

    _join_spinner = lv_spinner_create(_page_joining);
    lv_obj_set_size(_join_spinner, 96, 96);
    lv_spinner_set_anim_params(_join_spinner, 1200, 70);
    lv_obj_set_style_arc_width(_join_spinner, 8, LV_PART_MAIN);
    lv_obj_set_style_arc_width(_join_spinner, 8, LV_PART_INDICATOR);
    lv_obj_set_style_arc_color(_join_spinner, lv_color_hex(COLOR_CARD), LV_PART_MAIN);
    lv_obj_set_style_arc_color(_join_spinner, lv_color_hex(COLOR_ACCENT), LV_PART_INDICATOR);
    lv_obj_align(_join_spinner, LV_ALIGN_CENTER, 0, -60);

    _join_icon = create_label(_page_joining, COLOR_OK, &lv_font_montserrat_44);
    lv_obj_align(_join_icon, LV_ALIGN_CENTER, 0, -60);

    _join_text = create_label(_page_joining, COLOR_TEXT);
    lv_obj_set_width(_join_text, 320);
    lv_obj_set_style_text_align(_join_text, LV_TEXT_ALIGN_CENTER, 0);
    lv_label_set_long_mode(_join_text, LV_LABEL_LONG_MODE_WRAP);
    lv_obj_align(_join_text, LV_ALIGN_CENTER, 0, 36);

    _join_button = createButton(_page_joining, "返回", COLOR_ROW, 170, onResultButton);
    lv_obj_align(_join_button, LV_ALIGN_CENTER, 0, 130);
}

void Settings::showPage(Page page)
{
    _page = page;
    lv_obj_add_flag(_page_password, LV_OBJ_FLAG_HIDDEN);
    lv_obj_add_flag(_page_joining, LV_OBJ_FLAG_HIDDEN);
    if (_sheet != nullptr) {
        lv_obj_delete(_sheet);
        _sheet = nullptr;
    }
    if (page == Page::PASSWORD) {
        lv_textarea_set_text(_pw_text, "");
        lv_textarea_set_password_mode(_pw_text, true);
        lv_label_set_text(_pw_title, _target.c_str());
        lv_obj_remove_flag(_page_password, LV_OBJ_FLAG_HIDDEN);
    } else if (page == Page::JOINING) {
        _last_join = -1;
        lv_obj_remove_flag(_page_joining, LV_OBJ_FLAG_HIDDEN);
        refreshJoin();
    }
}

// ---------------------------------------------------------------- network list
void Settings::rebuildList()
{
    if (_list == nullptr) {
        return;
    }
    sys_net_ap_t scan[SYS_NET_MAX_SCAN];
    int scan_count = sys_net_scan_results(scan, SYS_NET_MAX_SCAN);
    char saved[SYS_NET_MAX_SAVED][33];
    int saved_count = sys_net_saved(saved, SYS_NET_MAX_SAVED);
    const bool connected = sys_net_state() == SYS_NET_CONNECTED;
    _connected_ssid = connected ? sys_net_ssid() : "";

    // In range (strongest first), then saved networks not in range; the current one on top
    _rows.clear();
    for (int i = 0; i < scan_count; i++) {
        _rows.push_back({scan[i].ssid, scan[i].rssi, scan[i].secure, scan[i].saved, true});
    }
    for (int i = 0; i < saved_count; i++) {
        bool found = false;
        for (const Row &r : _rows) {
            found = found || r.ssid == saved[i];
        }
        if (!found) {
            _rows.push_back({saved[i], -100, true, true, false});
        }
    }
    for (size_t i = 1; i < _rows.size(); i++) {
        if (_rows[i].ssid == _connected_ssid) {
            Row r = _rows[i];
            _rows.erase(_rows.begin() + i);
            _rows.insert(_rows.begin(), r);
            break;
        }
    }

    lv_obj_clean(_list);
    for (size_t i = 0; i < _rows.size(); i++) {
        const Row &r = _rows[i];
        const bool current = !_connected_ssid.empty() && r.ssid == _connected_ssid;

        lv_obj_t *row = create_plain(_list);
        lv_obj_set_size(row, LV_PCT(100), 56);
        lv_obj_set_style_radius(row, 16, 0);
        lv_obj_set_style_pad_hor(row, 16, 0);
        lv_obj_set_style_bg_opa(row, LV_OPA_COVER, 0);
        lv_obj_set_style_bg_color(row, lv_color_hex(COLOR_CARD), 0);
        lv_obj_set_style_bg_color(row, lv_color_hex(COLOR_PRESSED), LV_STATE_PRESSED);
        lv_obj_set_flex_flow(row, LV_FLEX_FLOW_ROW);
        lv_obj_set_flex_align(row, LV_FLEX_ALIGN_START, LV_FLEX_ALIGN_CENTER, LV_FLEX_ALIGN_CENTER);
        lv_obj_set_style_pad_column(row, 10, 0);
        lv_obj_add_flag(row, LV_OBJ_FLAG_CLICKABLE);
        lv_obj_add_flag(row, LV_OBJ_FLAG_SCROLL_ON_FOCUS);
        lv_obj_add_event_cb(row, onRowClicked, LV_EVENT_CLICKED, (void *)(intptr_t)i);

        // Leading mark: check = connected, dot = saved
        lv_obj_t *mark = create_label(row, current ? COLOR_OK : COLOR_ACCENT, &lv_font_montserrat_18);
        lv_obj_set_width(mark, 18);
        lv_label_set_text(mark, current ? LV_SYMBOL_OK : (r.saved ? LV_SYMBOL_BULLET : ""));

        lv_obj_t *name = create_label(row, r.in_range ? COLOR_TEXT : COLOR_DIM);
        lv_obj_set_flex_grow(name, 1);
        lv_label_set_long_mode(name, LV_LABEL_LONG_MODE_DOTS);
        lv_label_set_text(name, r.ssid.c_str());

        if (r.in_range) {
            if (r.secure) {
                create_lock(row);
            }
            create_signal_bars(row, r.rssi);
        }   // Out of range: the dimmed name says it
    }
    if (_rows.empty()) {
        lv_obj_t *label = create_label(_list, COLOR_DIM);
        lv_obj_set_width(label, LV_PCT(100));
        lv_obj_set_style_text_align(label, LV_TEXT_ALIGN_CENTER, 0);
        lv_label_set_text(label, sys_net_scanning() ? "正在搜索…" : "没有找到网络");
    }
}

void Settings::showSheet(const Row &row, bool connected)
{
    _sheet_ssid = row.ssid;
    _sheet = create_plain(_screen);
    lv_obj_set_size(_sheet, LV_PCT(100), LV_PCT(100));
    lv_obj_set_style_bg_opa(_sheet, LV_OPA_80, 0);
    lv_obj_set_style_bg_color(_sheet, lv_color_hex(COLOR_BG), 0);
    lv_obj_add_flag(_sheet, LV_OBJ_FLAG_CLICKABLE);     // Swallow taps on the list below

    lv_obj_t *card = create_plain(_sheet);
    lv_obj_set_size(card, 300, LV_SIZE_CONTENT);
    lv_obj_center(card);
    lv_obj_set_style_radius(card, 26, 0);
    lv_obj_set_style_pad_all(card, 18, 0);
    lv_obj_set_style_bg_opa(card, LV_OPA_COVER, 0);
    lv_obj_set_style_bg_color(card, lv_color_hex(COLOR_CARD), 0);
    lv_obj_set_flex_flow(card, LV_FLEX_FLOW_COLUMN);
    lv_obj_set_flex_align(card, LV_FLEX_ALIGN_START, LV_FLEX_ALIGN_CENTER, LV_FLEX_ALIGN_CENTER);
    lv_obj_set_style_pad_row(card, 10, 0);

    lv_obj_t *title = create_label(card, COLOR_TEXT);
    lv_obj_set_width(title, LV_PCT(100));
    lv_obj_set_style_text_align(title, LV_TEXT_ALIGN_CENTER, 0);
    lv_label_set_long_mode(title, LV_LABEL_LONG_MODE_DOTS);
    lv_label_set_text(title, row.ssid.c_str());

    // user_data: 0 = connect, 1 = change password, 2 = forget, 3 = cancel
    struct { const char *text; uint32_t color; int action; bool show; } buttons[] = {
        {"连接", COLOR_ACCENT, 0, !connected && row.in_range},
        {"修改密码", COLOR_ROW, 1, row.in_range && row.secure},
        {"忘记此网络", COLOR_ERR, 2, true},
        {"取消", COLOR_ROW, 3, true},
    };
    for (const auto &b : buttons) {
        if (!b.show) {
            continue;
        }
        lv_obj_t *btn = createButton(card, b.text, b.color, 250, onSheetButton);
        lv_obj_set_height(btn, 50);
        lv_obj_set_user_data(btn, (void *)(intptr_t)b.action);
    }
}

void Settings::openRow(int index)
{
    if (index < 0 || index >= (int)_rows.size() || _sheet != nullptr) {
        return;
    }
    const Row &r = _rows[index];
    const bool connected = !_connected_ssid.empty() && r.ssid == _connected_ssid;
    if (r.saved || connected) {
        showSheet(r, connected);
    } else if (!r.secure) {
        startJoin(r.ssid, "");
    } else {
        _target = r.ssid;
        showPage(Page::PASSWORD);
    }
}

void Settings::startJoin(const string &ssid, const char *password)
{
    _target = ssid;
    sys_net_join(ssid.c_str(), password);
    showPage(Page::JOINING);
}

// ---------------------------------------------------------------- periodic refresh (LVGL task)
// Small Latin text uses Montserrat 18; anything that may contain Chinese (SSIDs, messages) uses
// the CJK font, which only exists at 30 px
static bool is_ascii(const char *s)
{
    for (; *s; s++) {
        if ((unsigned char)*s >= 0x80) {
            return false;
        }
    }
    return true;
}

static void set_mixed_text(lv_obj_t *label, const char *text, const lv_font_t *cjk)
{
    const lv_font_t *font = is_ascii(text) ? &lv_font_montserrat_18 : cjk;
    if (lv_obj_get_style_text_font(label, LV_PART_MAIN) != font) {
        lv_obj_set_style_text_font(label, font, 0);
    }
    set_text_if_changed(label, text);
}

void Settings::refreshStatus()
{
    const char *ssid = sys_net_ssid();
    char ip[16] = "";
    char detail[64];
    uint32_t dot = COLOR_OFF;
    string title;
    switch (sys_net_state()) {
    case SYS_NET_CONNECTED:
        dot = COLOR_OK;
        title = ssid;
        sys_net_ip(ip, sizeof(ip));
        snprintf(detail, sizeof(detail), "%s    %d dBm", ip, sys_net_rssi());
        break;
    case SYS_NET_CONNECTING:
        dot = COLOR_WARN;
        title = "正在连接…";
        snprintf(detail, sizeof(detail), "%s", ssid);
        break;
    case SYS_NET_FAILED:
        dot = COLOR_ERR;
        title = "未连接";
        snprintf(detail, sizeof(detail), "重试已保存的网络");
        break;
    case SYS_NET_NO_CONFIG:
        title = "未连接";
        snprintf(detail, sizeof(detail), "请选择下方网络");
        break;
    default:
        title = "Wi-Fi 未启动";
        detail[0] = '\0';
        break;
    }
    lv_obj_set_style_bg_color(_status_dot, lv_color_hex(dot), 0);
    set_text_if_changed(_status_title, title.c_str());
    set_mixed_text(_status_detail, detail, _font);

    const char *host = sys_net_server_host();
    char server[96];
    if (host[0]) {
        snprintf(server, sizeof(server), "OTA  %s", host);
    } else {
        snprintf(server, sizeof(server), "未设置服务器地址");
    }
    set_mixed_text(_server, server, _font);

    const bool scanning = sys_net_scanning();
    if (scanning == lv_obj_has_flag(_rescan_spinner, LV_OBJ_FLAG_HIDDEN)) {
        if (scanning) {
            lv_obj_remove_flag(_rescan_spinner, LV_OBJ_FLAG_HIDDEN);
            lv_obj_add_flag(_rescan_btn, LV_OBJ_FLAG_HIDDEN);
        } else {
            lv_obj_add_flag(_rescan_spinner, LV_OBJ_FLAG_HIDDEN);
            lv_obj_remove_flag(_rescan_btn, LV_OBJ_FLAG_HIDDEN);
        }
    }
}

void Settings::refreshJoin()
{
    const int state = sys_net_join_state();
    if (state == _last_join) {
        if (state == SYS_NET_JOIN_OK && lv_tick_elaps(_join_ok_tick) >= JOIN_OK_SHOW_MS) {
            showPage(Page::MAIN);
        }
        return;
    }
    _last_join = state;

    const bool busy = (state == SYS_NET_JOIN_BUSY);
    if (busy) {
        lv_obj_remove_flag(_join_spinner, LV_OBJ_FLAG_HIDDEN);
        lv_obj_add_flag(_join_icon, LV_OBJ_FLAG_HIDDEN);
        lv_obj_add_flag(_join_button, LV_OBJ_FLAG_HIDDEN);
    } else {
        lv_obj_add_flag(_join_spinner, LV_OBJ_FLAG_HIDDEN);
        lv_obj_remove_flag(_join_icon, LV_OBJ_FLAG_HIDDEN);
        lv_obj_remove_flag(_join_button, LV_OBJ_FLAG_HIDDEN);
    }

    string text;
    lv_obj_t *button_label = lv_obj_get_child(_join_button, 0);
    switch (state) {
    case SYS_NET_JOIN_BUSY:
        text = "正在连接\n" + _target;
        break;
    case SYS_NET_JOIN_OK:
        _join_ok_tick = lv_tick_get();
        lv_obj_add_flag(_join_button, LV_OBJ_FLAG_HIDDEN);
        lv_obj_set_style_text_color(_join_icon, lv_color_hex(COLOR_OK), 0);
        lv_label_set_text(_join_icon, LV_SYMBOL_OK);
        text = "已连接\n" + _target;
        break;
    case SYS_NET_JOIN_FAIL_AUTH:
        lv_obj_set_style_text_color(_join_icon, lv_color_hex(COLOR_ERR), 0);
        lv_label_set_text(_join_icon, LV_SYMBOL_CLOSE);
        lv_label_set_text(button_label, "重新输入");
        text = "密码错误";
        break;
    case SYS_NET_JOIN_FAIL_NOT_FOUND:
        lv_obj_set_style_text_color(_join_icon, lv_color_hex(COLOR_WARN), 0);
        lv_label_set_text(_join_icon, LV_SYMBOL_WARNING);
        lv_label_set_text(button_label, "返回");
        text = "找不到该网络\n请靠近路由器后重试";
        break;
    default:
        lv_obj_set_style_text_color(_join_icon, lv_color_hex(COLOR_ERR), 0);
        lv_label_set_text(_join_icon, LV_SYMBOL_CLOSE);
        lv_label_set_text(button_label, "返回");
        text = "连接失败";
        break;
    }
    lv_label_set_text(_join_text, text.c_str());
}

void Settings::refresh()
{
    const lv_font_t *font = music_font_get(&lv_font_montserrat_24);
    if (font != _font) {
        _font = font;
        lv_obj_set_style_text_font(_screen, _font, 0);  // Inherited by every label without its own font
    }

    refreshStatus();
    if (_page == Page::JOINING) {
        refreshJoin();
    }

    // Rebuild the list only when something it shows changed
    char saved[SYS_NET_MAX_SAVED][33];
    int saved_count = sys_net_saved(saved, SYS_NET_MAX_SAVED);
    string sig;
    for (int i = 0; i < saved_count; i++) {
        sig += saved[i];
        sig += '\n';
    }
    const string connected = (sys_net_state() == SYS_NET_CONNECTED) ? sys_net_ssid() : "";
    const uint32_t gen = sys_net_scan_gen();
    if (gen != _scan_gen || sig != _saved_sig || connected != _connected_ssid) {
        _scan_gen = gen;
        _saved_sig = sig;
        rebuildList();
    }
}

void Settings::onTimer(lv_timer_t *timer)
{
    Settings *app = static_cast<Settings *>(lv_timer_get_user_data(timer));
    if (app != nullptr && app->_screen != nullptr) {
        app->refresh();
    }
}

// ---------------------------------------------------------------- event handlers
void Settings::onRowClicked(lv_event_t *e)
{
    if (_instance != nullptr) {
        _instance->openRow((int)(intptr_t)lv_event_get_user_data(e));
    }
}

void Settings::onRescan(lv_event_t *e)
{
    sys_net_scan();
}

void Settings::onSheetButton(lv_event_t *e)
{
    Settings *self = _instance;
    if (self == nullptr) {
        return;
    }
    const int action = (int)(intptr_t)lv_obj_get_user_data((lv_obj_t *)lv_event_get_current_target(e));
    const string ssid = self->_sheet_ssid;
    // Deleting the sheet from its own button's event is not allowed: do it asynchronously
    lv_obj_delete_async(self->_sheet);
    self->_sheet = nullptr;
    switch (action) {
    case 0:
        self->startJoin(ssid, nullptr);
        break;
    case 1:
        self->_target = ssid;
        self->showPage(Page::PASSWORD);
        break;
    case 2:
        sys_net_forget(ssid.c_str());
        break;
    default:
        break;
    }
}

void Settings::onKeyboard(lv_event_t *e)
{
    if (lv_event_get_code(e) == LV_EVENT_READY) {
        onPasswordConnect(e);
    } else {
        onPasswordCancel(e);
    }
}

void Settings::onEyeToggle(lv_event_t *e)
{
    if (_instance != nullptr) {
        lv_obj_t *ta = _instance->_pw_text;
        lv_textarea_set_password_mode(ta, !lv_textarea_get_password_mode(ta));
    }
}

void Settings::onPasswordCancel(lv_event_t *e)
{
    if (_instance != nullptr) {
        _instance->showPage(Page::MAIN);
    }
}

void Settings::onPasswordConnect(lv_event_t *e)
{
    Settings *self = _instance;
    if (self == nullptr) {
        return;
    }
    const char *pw = lv_textarea_get_text(self->_pw_text);
    if (strlen(pw) < 8) {               // WPA2/WPA3 passwords are 8..63 characters
        lv_textarea_set_placeholder_text(self->_pw_text, "8+ characters");
        return;
    }
    string password = pw;
    lv_textarea_set_text(self->_pw_text, "");
    self->startJoin(self->_target, password.c_str());
}

void Settings::onResultButton(lv_event_t *e)
{
    Settings *self = _instance;
    if (self == nullptr) {
        return;
    }
    if (sys_net_join_state() == SYS_NET_JOIN_FAIL_AUTH) {
        self->showPage(Page::PASSWORD);
    } else {
        self->showPage(Page::MAIN);
    }
}

// ---------------------------------------------------------------- app lifecycle
bool Settings::run(void)
{
    ESP_UTILS_LOGD("Run");
    if (!s_init_started) {
        s_init_started = true;
        xTaskCreate(init_task, "settings_init", 4 * 1024, nullptr, 4, nullptr);
    }
    _font = music_font_get(&lv_font_montserrat_24);

    _screen = lv_scr_act();
    lv_obj_set_style_bg_color(_screen, lv_color_hex(COLOR_BG), 0);
    lv_obj_set_style_bg_opa(_screen, LV_OPA_COVER, 0);
    lv_obj_set_style_text_font(_screen, _font, 0);
    lv_obj_remove_flag(_screen, LV_OBJ_FLAG_SCROLLABLE);

    buildMain(_screen);
    buildPassword(_screen);
    buildJoining(_screen);
    _sheet = nullptr;
    _page = Page::MAIN;
    lv_obj_add_flag(_page_password, LV_OBJ_FLAG_HIDDEN);
    lv_obj_add_flag(_page_joining, LV_OBJ_FLAG_HIDDEN);

    _scan_gen = sys_net_scan_gen();
    _saved_sig = "\x01";                // Force the first build
    refresh();
    sys_net_scan();
    lv_timer_create(onTimer, REFRESH_MS, this);
    return true;
}

bool Settings::back(void)
{
    ESP_UTILS_LOGD("Back");
    // Sub-page / sheet open: go back to the list instead of closing the app
    if (_screen != nullptr && (_page != Page::MAIN || _sheet != nullptr)) {
        showPage(Page::MAIN);
        return true;
    }
    // UI objects are recycled by the core
    _screen = _page_main = _page_password = _page_joining = nullptr;
    _status_dot = _status_title = _status_detail = _rescan_btn = _rescan_spinner = nullptr;
    _list = _server = _pw_title = _pw_text = nullptr;
    _join_spinner = _join_icon = _join_text = _join_button = _sheet = nullptr;
    ESP_UTILS_CHECK_FALSE_RETURN(notifyCoreClosed(), false, "Notify core closed failed");
    return true;
}

// Auto-register this app into the registry so the launcher installs it automatically
ESP_UTILS_REGISTER_PLUGIN_WITH_CONSTRUCTOR(systems::base::App, Settings, APP_NAME, []()
{
    return std::shared_ptr<Settings>(Settings::requestInstance(), [](Settings * p) {});
})

} // namespace esp_brookesia::apps
