/*
 * SPDX-FileCopyrightText: 2025
 *
 * SPDX-License-Identifier: Apache-2.0
 */
#include <cstring>
#include "lvgl.h"
#include "esp_ota_ops.h"
#include "esp_system.h"
#include "esp_heap_caps.h"
#include "freertos/FreeRTOS.h"
#include "freertos/task.h"
#include "esp_brookesia.hpp"
#ifdef ESP_UTILS_LOG_TAG
#   undef ESP_UTILS_LOG_TAG
#endif
#define ESP_UTILS_LOG_TAG "BS:XiaoZhi"
#include "esp_lib_utils.h"
#include "esp_brookesia_app_xiaozhi.hpp"

#define APP_NAME "AI Chat"
// project(...) name of the XiaoZhi firmware, stored in its app description
#define XIAOZHI_PROJECT_NAME "xiaozhi"
// Delay before rebooting, so the hint label gets rendered
#define SWITCH_DELAY_MS 300

LV_IMG_DECLARE(esp_brookesia_app_icon_ai_chat);

using namespace std;
using namespace esp_brookesia::gui;
using namespace esp_brookesia::systems;

namespace esp_brookesia::apps {

XiaoZhi *XiaoZhi::_instance = nullptr;

// Find the other OTA slot and check that it holds a XiaoZhi image
static const esp_partition_t *find_xiaozhi_partition()
{
    const esp_partition_t *partition = esp_ota_get_next_update_partition(nullptr);
    if (partition == nullptr) {
        ESP_UTILS_LOGE("No other OTA slot (is the dual-boot partition table flashed?)");
        return nullptr;
    }

    esp_app_desc_t desc = {};
    if (esp_ota_get_partition_description(partition, &desc) != ESP_OK) {
        ESP_UTILS_LOGE("Slot %s holds no valid app", partition->label);
        return nullptr;
    }
    if (strcmp(desc.project_name, XIAOZHI_PROJECT_NAME) != 0) {
        ESP_UTILS_LOGE("Slot %s holds '%s', not XiaoZhi", partition->label, desc.project_name);
        return nullptr;
    }
    ESP_UTILS_LOGI("Found XiaoZhi %s in slot %s", desc.version, partition->label);
    return partition;
}

void XiaoZhi::markRunningAppValid()
{
    esp_ota_img_states_t state = ESP_OTA_IMG_UNDEFINED;
    const esp_partition_t *running = esp_ota_get_running_partition();
    if ((esp_ota_get_state_partition(running, &state) == ESP_OK) && (state == ESP_OTA_IMG_PENDING_VERIFY)) {
        ESP_UTILS_LOGI("Mark launcher in slot %s as valid", running->label);
        esp_ota_mark_app_valid_cancel_rollback();
    }
}

XiaoZhi *XiaoZhi::requestInstance()
{
    if (_instance == nullptr) {
        _instance = new XiaoZhi();
    }
    return _instance;
}

// name="AI Chat", launcher_icon=esp_brookesia_app_icon_ai_chat (assets/, generated by tools/make_icons.py), use_default_screen=true
XiaoZhi::XiaoZhi():
    App(APP_NAME, &esp_brookesia_app_icon_ai_chat, true)
{
}

XiaoZhi::~XiaoZhi()
{
}

// Writing otadata freezes the flash cache. The LVGL task stack lives in PSRAM
// (main.cpp: stack_in_psram), which is inaccessible while the cache is frozen and
// asserts in esp_cache_freeze_caches_disable_interrupts. So do the switch in a
// separate task whose stack is in internal RAM.
//
// The stack is reserved statically (.bss is internal RAM): creating the task can never fail
// for lack of memory. With WiFi, scans and fonts loaded, internal RAM can get too fragmented
// for a dynamic 4 KB stack, and the switch then silently stayed on "Starting AI Chat...".
#define SWITCH_STACK_SIZE 4096
static StackType_t s_switch_stack[SWITCH_STACK_SIZE / sizeof(StackType_t)];
static StaticTask_t s_switch_tcb;
static volatile bool s_switch_started;
static volatile esp_err_t s_switch_error = ESP_OK;

static void switch_task(void *arg)
{
    const esp_partition_t *partition = static_cast<const esp_partition_t *>(arg);
    ESP_UTILS_LOGI("Switching to %s (free internal RAM %u, largest block %u)", partition->label,
                   (unsigned)heap_caps_get_free_size(MALLOC_CAP_INTERNAL),
                   (unsigned)heap_caps_get_largest_free_block(MALLOC_CAP_INTERNAL));
    esp_err_t err = esp_ota_set_boot_partition(partition);
    if (err != ESP_OK) {
        ESP_UTILS_LOGE("Set boot partition failed: %s", esp_err_to_name(err));
        s_switch_error = err;           // Shown by onSwitchTimer()
        s_switch_started = false;
        vTaskDelete(nullptr);
        return;
    }
    ESP_UTILS_LOGI("Boot partition set, restarting");
    esp_restart();
}

// First call: start the switch. Then keeps polling, so a failure is shown instead of hanging.
void XiaoZhi::onSwitchTimer(lv_timer_t *timer)
{
    if (s_switch_error != ESP_OK) {
        lv_timer_delete(timer);
        if (_instance != nullptr && _instance->_hint_label != nullptr) {
            lv_obj_set_style_text_color(_instance->_hint_label, lv_color_hex(0xFF7043), 0);
            lv_label_set_text_fmt(_instance->_hint_label, "Switch failed: %s\nSwipe back to exit",
                                  esp_err_to_name(s_switch_error));
        }
        s_switch_error = ESP_OK;
        return;
    }
    if (s_switch_started) {
        return;                         // Waiting for the restart
    }
    s_switch_started = true;
    void *partition = lv_timer_get_user_data(timer);
    xTaskCreateStatic(switch_task, "to_xiaozhi", SWITCH_STACK_SIZE,  // ESP-IDF: stack depth in bytes
                      partition, 5, s_switch_stack, &s_switch_tcb);
}

bool XiaoZhi::run(void)
{
    ESP_UTILS_LOGD("Run");

    lv_obj_t *scr = lv_scr_act();
    lv_obj_set_style_bg_color(scr, lv_color_black(), 0);
    lv_obj_set_style_bg_opa(scr, LV_OPA_COVER, 0);

    _hint_label = lv_label_create(scr);
    lv_obj_set_style_text_font(_hint_label, &lv_font_montserrat_24, 0);
    lv_obj_set_style_text_align(_hint_label, LV_TEXT_ALIGN_CENTER, 0);
    lv_obj_align(_hint_label, LV_ALIGN_CENTER, 0, 0);

    const esp_partition_t *partition = find_xiaozhi_partition();
    if (partition == nullptr) {
        lv_obj_set_style_text_color(_hint_label, lv_color_hex(0xFF7043), 0);
        lv_label_set_text(_hint_label, "XiaoZhi not installed\nSwipe back to exit");
        return true;
    }

    lv_obj_set_style_text_color(_hint_label, lv_color_white(), 0);
    lv_label_set_text(_hint_label, "Starting AI Chat...");
    if (!s_switch_started) {
        lv_timer_create(onSwitchTimer, SWITCH_DELAY_MS, const_cast<esp_partition_t *>(partition));
    }

    return true;
}

bool XiaoZhi::back(void)
{
    ESP_UTILS_LOGD("Back");

    ESP_UTILS_CHECK_FALSE_RETURN(notifyCoreClosed(), false, "Notify core closed failed");

    return true;
}

// Auto-register this app into the registry so the launcher installs it automatically
// (no need to edit main.cpp).
ESP_UTILS_REGISTER_PLUGIN_WITH_CONSTRUCTOR(systems::base::App, XiaoZhi, APP_NAME, []()
{
    return std::shared_ptr<XiaoZhi>(XiaoZhi::requestInstance(), [](XiaoZhi * p) {});
})

} // namespace esp_brookesia::apps
