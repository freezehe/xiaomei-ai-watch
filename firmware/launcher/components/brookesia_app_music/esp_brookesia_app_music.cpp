/*
 * SPDX-FileCopyrightText: 2025
 *
 * SPDX-License-Identifier: Apache-2.0
 */
#include <cstdio>
#include <cstring>
#include "lvgl.h"
#include "esp_brookesia.hpp"
#include "freertos/task.h"
#ifdef ESP_UTILS_LOG_TAG
#   undef ESP_UTILS_LOG_TAG
#endif
#define ESP_UTILS_LOG_TAG "BS:Music"
#include "esp_lib_utils.h"
#include "esp_brookesia_app_music.hpp"
#include "music_font.h"
#include "music_net.h"
#include "music_player.h"

#define APP_NAME "Music"

#define COLOR_BG        0x000000
#define COLOR_TEXT      0xFFFFFF
#define COLOR_DIM       0x9E9E9E
#define COLOR_ACCENT    0x7C4DFF
#define COLOR_ROW       0x1E1E2A
#define COLOR_ROW_NOW   0x3A2C6E

#define REFRESH_MS      300
#define RETRY_MS        5000            // Retry a failed list fetch
#define MUSIC_LIST_W          330
#define MUSIC_LIST_H          190

LV_IMG_DECLARE(esp_brookesia_app_icon_music);

using namespace std;
using namespace esp_brookesia::gui;
using namespace esp_brookesia::systems;

namespace esp_brookesia::apps {

Music *Music::_instance = nullptr;

// Initialisation reads flash (NVS WiFi config, PHY calibration data, XiaoZhi's assets partition).
// Flash access disables the cache, which asserts when the calling task's stack is in PSRAM -
// and the LVGL task's stack is (main.cpp: stack_in_psram). So it runs in its own task, whose
// stack xTaskCreate() allocates from internal RAM, while the UI shows "initialising".
static bool s_init_started;
static volatile bool s_init_done;

static void init_task(void *arg)
{
    music_net_start();
    music_player_init();
    music_font_load(&lv_font_montserrat_24);
    s_init_done = true;
    vTaskDelete(nullptr);
}

Music *Music::requestInstance()
{
    if (_instance == nullptr) {
        _instance = new Music();
    }
    return _instance;
}

// name="Music", launcher_icon=esp_brookesia_app_icon_music (assets/, generated by tools/make_icons.py), use_default_screen=true
Music::Music():
    App(APP_NAME, &esp_brookesia_app_icon_music, true)
{
    _lock = xSemaphoreCreateMutex();
}

Music::~Music()
{
}

// ---------------------------------------------------------------- list fetching (worker task)
void Music::fetchTask(void *arg)
{
    Music *self = static_cast<Music *>(arg);
    xSemaphoreTake(self->_lock, portMAX_DELAY);
    string dir = self->_fetch_dir;
    xSemaphoreGive(self->_lock);

    music_entry_t *entries = nullptr;
    int count = 0;
    esp_err_t err = music_net_fetch_list(dir.c_str(), &entries, &count);
    vector<Entry> result;
    for (int i = 0; i < count; i++) {
        result.push_back({entries[i].name, entries[i].is_dir});
    }
    music_net_free_list(entries, count);

    xSemaphoreTake(self->_lock, portMAX_DELAY);
    self->_fetched = std::move(result);
    self->_fetch_error = (err == ESP_OK) ? "" : "获取歌曲列表失败";
    self->_fetch_done = true;
    xSemaphoreGive(self->_lock);
    vTaskDelete(nullptr);
}

void Music::startFetch(const string &dir)
{
    if (_loading) {
        return;
    }
    xSemaphoreTake(_lock, portMAX_DELAY);
    _fetch_dir = dir;
    _fetch_done = false;
    xSemaphoreGive(_lock);
    _loading = true;
    if (xTaskCreate(fetchTask, "music_list", 6 * 1024, this, 3, nullptr) != pdPASS) {
        _loading = false;
        _error = "内存不足";
    }
}

// ---------------------------------------------------------------- list widget
void Music::rebuildList()
{
    if (_list == nullptr) {
        return;
    }
    lv_obj_clean(_list);

    int rows = (int)_entries.size() + (_dir.empty() ? 0 : 1);
    for (int i = -(_dir.empty() ? 0 : 1); i < (int)_entries.size(); i++) {
        string text;
        if (i < 0) {
            text = string(LV_SYMBOL_UP) + "  返回上级";
        } else {
            text = string(_entries[i].is_dir ? LV_SYMBOL_DIRECTORY : LV_SYMBOL_AUDIO) + "  " + _entries[i].name;
        }
        lv_obj_t *row = lv_obj_create(_list);
        lv_obj_remove_style_all(row);
        lv_obj_set_size(row, LV_PCT(100), LV_SIZE_CONTENT);
        lv_obj_set_style_pad_all(row, 8, 0);
        lv_obj_set_style_radius(row, 12, 0);
        lv_obj_set_style_bg_opa(row, LV_OPA_COVER, 0);
        lv_obj_set_style_bg_color(row, lv_color_hex(COLOR_ROW), 0);
        lv_obj_set_style_bg_color(row, lv_color_hex(COLOR_ACCENT), LV_STATE_PRESSED);
        lv_obj_add_flag(row, LV_OBJ_FLAG_CLICKABLE);
        lv_obj_add_event_cb(row, onRowClicked, LV_EVENT_CLICKED, (void *)(intptr_t)i);

        lv_obj_t *label = lv_label_create(row);
        lv_obj_set_width(label, LV_PCT(100));
        lv_label_set_long_mode(label, LV_LABEL_LONG_MODE_DOTS);
        lv_obj_set_style_text_font(label, _font, 0);
        lv_obj_set_style_text_color(label, lv_color_hex(COLOR_TEXT), 0);
        lv_label_set_text(label, text.c_str());
    }
    if (rows == 0 && _loaded) {
        lv_obj_t *label = lv_label_create(_list);
        lv_obj_set_style_text_font(label, _font, 0);
        lv_obj_set_style_text_color(label, lv_color_hex(COLOR_DIM), 0);
        lv_label_set_text(label, "这里没有歌曲");
    }
    _list_dirty = false;
}

void Music::openEntry(int index)
{
    if (index < 0) {                            // ".." -> parent directory
        size_t pos = _dir.find_last_of('/', _dir.size() >= 2 ? _dir.size() - 2 : 0);
        _dir = (pos == string::npos) ? "" : _dir.substr(0, pos + 1);
        _loaded = false;
        startFetch(_dir);
        return;
    }
    if (index >= (int)_entries.size()) {
        return;
    }
    if (_entries[index].is_dir) {
        _dir += _entries[index].name + "/";
        _loaded = false;
        startFetch(_dir);
        return;
    }
    // Playlist = all files of this directory, starting at the tapped one
    char base[256];
    if (!music_net_base_url(base, sizeof(base))) {
        return;
    }
    vector<const char *> names;
    int start = 0;
    for (int i = 0; i < (int)_entries.size(); i++) {
        if (!_entries[i].is_dir) {
            if (i == index) {
                start = (int)names.size();
            }
            names.push_back(_entries[i].name.c_str());
        }
    }
    music_player_play_list(base, _dir.c_str(), names.data(), (int)names.size(), start);
}

// ---------------------------------------------------------------- periodic refresh (LVGL task)
// Setting a label invalidates (redraws) it even with the same text: only set what changed
static void set_text_if_changed(lv_obj_t *label, const char *text)
{
    if (strcmp(lv_label_get_text(label), text) != 0) {
        lv_label_set_text(label, text);
    }
}

static string format_time(uint32_t ms)
{
    char buf[16];
    snprintf(buf, sizeof(buf), "%02lu:%02lu", (unsigned long)(ms / 60000), (unsigned long)(ms / 1000 % 60));
    return buf;
}

void Music::refresh()
{
    if (!s_init_done) {
        set_text_if_changed(_status, "正在初始化…");
        return;
    }
    const lv_font_t *font = music_font_get(&lv_font_montserrat_24);
    if (font != _font) {
        _font = font;
        lv_obj_set_style_text_font(_title, _font, 0);
        lv_obj_set_style_text_font(_status, _font, 0);
        _list_dirty = true;
    }

    // 1. Network / list loading
    string net_text;
    char base[256];
    switch (music_net_state()) {
    case MUSIC_NET_NO_CONFIG:
        net_text = "请先在设置里连接 Wi-Fi";
        break;
    case MUSIC_NET_CONNECTING:
        net_text = string("连接 Wi-Fi：") + music_net_ssid();
        break;
    case MUSIC_NET_FAILED:
        net_text = "Wi-Fi 连接失败，重试中";
        break;
    case MUSIC_NET_CONNECTED:
        if (!music_net_base_url(base, sizeof(base))) {
            net_text = "请先在小智里配置 OTA 地址";
        } else if (!_loaded && !_loading && (_error.empty() || lv_tick_elaps(_error_tick) >= RETRY_MS)) {
            startFetch(_dir);
        }
        break;
    default:
        break;
    }
    if (_loading) {
        xSemaphoreTake(_lock, portMAX_DELAY);
        bool done = _fetch_done;
        if (done) {
            _entries = std::move(_fetched);
            _error = _fetch_error;
            _fetch_done = false;
        }
        xSemaphoreGive(_lock);
        if (done) {
            _loading = false;
            _loaded = _error.empty();
            _error_tick = lv_tick_get();
            _list_dirty = true;
        }
    }
    if (_list_dirty) {
        rebuildList();
    }

    // 2. Player status
    music_player_status_t st;
    music_player_get_status(&st);
    string status;
    switch (st.state) {
    case MUSIC_PLAYER_BUFFERING:
        status = "缓冲中 " + to_string(st.buffer_pct) + "%";
        break;
    case MUSIC_PLAYER_PLAYING:
        status = string(LV_SYMBOL_PLAY) + " " + format_time(st.elapsed_ms) + "   " +
                 to_string(st.index + 1) + "/" + to_string(st.count);
        break;
    case MUSIC_PLAYER_PAUSED:
        status = string(LV_SYMBOL_PAUSE) + " 已暂停 " + format_time(st.elapsed_ms);
        break;
    case MUSIC_PLAYER_ERROR:
        status = st.message;
        break;
    default:
        status = _loading ? "加载歌曲列表…" : (_error.empty() ? "点一首歌开始播放" : _error);
        break;
    }
    if (!net_text.empty() && st.state == MUSIC_PLAYER_STOPPED) {
        status = net_text;
    }
    set_text_if_changed(_status, status.c_str());

    const char *title = (st.index >= 0 && st.title[0]) ? st.title : "音乐";
    set_text_if_changed(_title, title);
    bool active = (st.state == MUSIC_PLAYER_PLAYING || st.state == MUSIC_PLAYER_BUFFERING);
    set_text_if_changed(_play_label, active ? LV_SYMBOL_PAUSE : LV_SYMBOL_PLAY);
    if (!lv_slider_is_dragged(_volume) && lv_slider_get_value(_volume) != st.volume) {
        lv_slider_set_value(_volume, st.volume, LV_ANIM_OFF);
    }
}

void Music::onTimer(lv_timer_t *timer)
{
    Music *app = static_cast<Music *>(lv_timer_get_user_data(timer));
    if (app != nullptr) {
        app->refresh();
    }
}

// ---------------------------------------------------------------- event handlers
void Music::onRowClicked(lv_event_t *e)
{
    if (_instance != nullptr) {
        _instance->openEntry((int)(intptr_t)lv_event_get_user_data(e));
    }
}

void Music::onPrev(lv_event_t *e) { music_player_prev(); }
void Music::onPlay(lv_event_t *e) { music_player_toggle_pause(); }
void Music::onNext(lv_event_t *e) { music_player_next(); }

void Music::onVolume(lv_event_t *e)
{
    music_player_set_volume(lv_slider_get_value((lv_obj_t *)lv_event_get_target(e)));
}

lv_obj_t *Music::createControlButton(lv_obj_t *parent, const char *symbol, int size, lv_event_cb_t cb)
{
    lv_obj_t *btn = lv_button_create(parent);
    lv_obj_set_size(btn, size, size);
    lv_obj_set_style_radius(btn, LV_RADIUS_CIRCLE, 0);
    lv_obj_set_style_bg_color(btn, lv_color_hex(size > 70 ? COLOR_ACCENT : COLOR_ROW), 0);
    lv_obj_set_style_shadow_width(btn, 0, 0);
    lv_obj_add_event_cb(btn, cb, LV_EVENT_CLICKED, nullptr);
    lv_obj_t *label = lv_label_create(btn);
    lv_obj_set_style_text_font(label, size > 70 ? &lv_font_montserrat_36 : &lv_font_montserrat_28, 0);
    lv_obj_set_style_text_color(label, lv_color_hex(COLOR_TEXT), 0);
    lv_label_set_text(label, symbol);
    lv_obj_center(label);
    return btn;
}

// ---------------------------------------------------------------- app lifecycle
bool Music::run(void)
{
    ESP_UTILS_LOGD("Run");
    if (!s_init_started) {
        s_init_started = true;
        xTaskCreate(init_task, "music_init", 6 * 1024, nullptr, 4, nullptr);
    }
    _font = music_font_get(&lv_font_montserrat_24);

    lv_obj_t *scr = lv_scr_act();
    lv_obj_set_style_bg_color(scr, lv_color_hex(COLOR_BG), 0);
    lv_obj_set_style_bg_opa(scr, LV_OPA_COVER, 0);
    lv_obj_remove_flag(scr, LV_OBJ_FLAG_SCROLLABLE);

    _title = lv_label_create(scr);
    lv_obj_set_width(_title, 290);
    lv_label_set_long_mode(_title, LV_LABEL_LONG_MODE_SCROLL_CIRCULAR);
    lv_obj_set_style_text_align(_title, LV_TEXT_ALIGN_CENTER, 0);
    lv_obj_set_style_text_font(_title, _font, 0);
    lv_obj_set_style_text_color(_title, lv_color_hex(COLOR_TEXT), 0);
    lv_label_set_text(_title, "音乐");
    lv_obj_align(_title, LV_ALIGN_TOP_MID, 0, 36);

    _status = lv_label_create(scr);
    lv_obj_set_width(_status, 330);
    lv_label_set_long_mode(_status, LV_LABEL_LONG_MODE_DOTS);
    lv_obj_set_style_text_align(_status, LV_TEXT_ALIGN_CENTER, 0);
    lv_obj_set_style_text_font(_status, _font, 0);
    lv_obj_set_style_text_color(_status, lv_color_hex(COLOR_DIM), 0);
    lv_label_set_text(_status, "");
    lv_obj_align(_status, LV_ALIGN_TOP_MID, 0, 76);

    _list = lv_obj_create(scr);
    lv_obj_remove_style_all(_list);
    lv_obj_set_size(_list, MUSIC_LIST_W, MUSIC_LIST_H);
    lv_obj_align(_list, LV_ALIGN_TOP_MID, 0, 120);
    lv_obj_set_flex_flow(_list, LV_FLEX_FLOW_COLUMN);
    lv_obj_set_style_pad_row(_list, 6, 0);
    lv_obj_set_scroll_dir(_list, LV_DIR_VER);
    lv_obj_set_scrollbar_mode(_list, LV_SCROLLBAR_MODE_OFF);

    lv_obj_t *controls = lv_obj_create(scr);
    lv_obj_remove_style_all(controls);
    lv_obj_set_size(controls, 300, 90);
    lv_obj_align(controls, LV_ALIGN_TOP_MID, 0, 318);
    lv_obj_set_flex_flow(controls, LV_FLEX_FLOW_ROW);
    lv_obj_set_flex_align(controls, LV_FLEX_ALIGN_SPACE_EVENLY, LV_FLEX_ALIGN_CENTER, LV_FLEX_ALIGN_CENTER);
    createControlButton(controls, LV_SYMBOL_PREV, 62, onPrev);
    lv_obj_t *play = createControlButton(controls, LV_SYMBOL_PLAY, 82, onPlay);
    _play_label = lv_obj_get_child(play, 0);
    createControlButton(controls, LV_SYMBOL_NEXT, 62, onNext);

    _volume = lv_slider_create(scr);
    lv_obj_set_size(_volume, 190, 8);
    lv_slider_set_range(_volume, 0, 100);
    lv_obj_set_style_bg_color(_volume, lv_color_hex(COLOR_ACCENT), LV_PART_INDICATOR);
    lv_obj_set_style_bg_color(_volume, lv_color_hex(COLOR_TEXT), LV_PART_KNOB);
    lv_obj_align(_volume, LV_ALIGN_TOP_MID, 12, 422);
    lv_obj_add_event_cb(_volume, onVolume, LV_EVENT_VALUE_CHANGED, nullptr);
    lv_obj_t *vol_icon = lv_label_create(scr);
    lv_obj_set_style_text_font(vol_icon, &lv_font_montserrat_20, 0);
    lv_obj_set_style_text_color(vol_icon, lv_color_hex(COLOR_DIM), 0);
    lv_label_set_text(vol_icon, LV_SYMBOL_VOLUME_MAX);
    lv_obj_align_to(vol_icon, _volume, LV_ALIGN_OUT_LEFT_MID, -14, 0);

    // Show the cached list at once; the timer loads/refreshes the rest
    _list_dirty = true;
    _error.clear();
    refresh();
    lv_timer_create(onTimer, REFRESH_MS, this);
    return true;
}

bool Music::back(void)
{
    ESP_UTILS_LOGD("Back");
    // UI objects are recycled by the core; playback continues in the background
    _title = _status = _list = _play_label = _volume = nullptr;
    ESP_UTILS_CHECK_FALSE_RETURN(notifyCoreClosed(), false, "Notify core closed failed");
    return true;
}

// Auto-register this app into the registry so the launcher installs it automatically
ESP_UTILS_REGISTER_PLUGIN_WITH_CONSTRUCTOR(systems::base::App, Music, APP_NAME, []()
{
    return std::shared_ptr<Music>(Music::requestInstance(), [](Music * p) {});
})

} // namespace esp_brookesia::apps
